#include "stdafx.h"
#include "cpu.h"
#include "vga.h"
#include "ioports.h"

#define VMODE_BW40x25		0x00
#define VMODE_COL40x25		0x01
#define VMODE_BW80x25		0x02
#define VMODE_COL80x25		0x03
#define VMODE_COL320x200	0x04
#define VMODE_BW320x200		0x05
#define VMODE_BW640x200		0x06
#define VMODE_EGA320x200	0x09
#define VMODE_EGA320x200D	0x0D
#define VMODE_EGA640x350	0x10
#define VMODE_BW640x480		0x11
#define VMODE_VGA640x480	0x12
#define VMODE_VGA320x200	0x13
#define VMODE_VGA640x480x8	0x14

#ifndef COLORREF
#define COLORREF	unsigned int
#endif

#ifndef BYTE
#define BYTE		unsigned char
#endif

#ifndef WORD
#define WORD		unsigned short
#endif

#ifndef DWORD
#define DWORD unsigned int
#endif

#ifndef RGB
#define RGB(r,g,b)          ((COLORREF)(((BYTE)(r)|((WORD)((BYTE)(g))<<8))|(((DWORD)(BYTE)(b))<<16)))
#endif

#if (STM32)
unsigned long GetTickCount(void);
#endif

typedef union
{
	unsigned char b[4];
	unsigned short w[2];
	unsigned int d;
} reg_t;

int vmode = 3;
int vga_lines = 400;

unsigned char crt_regs[32] = {0};
unsigned char cga_color_cr = 0;
unsigned char vga_palette[1024] = {0};
unsigned int ega_palette[16] = {0};
int vga_pan = 0;
int vga_3da = 0;
int vga_pal_mask = 0xFF;
int vga_pal_index = 0;
int vga_pal_read_index = 0;
int vga_read_map = 0;

unsigned char ac_regs[32];
unsigned char sq_regs[16] = {0, 0, 0, 0, 0xFF};
unsigned char gc_regs[32];

unsigned char ac_index = 0;
unsigned char sq_index = 0;
unsigned char gc_index = 0;
unsigned char crt_index = 0;

unsigned int vga_plane_mask = 0xFFFFFFFFu;
unsigned int write_mask = 0xFFFFFFFFu;
reg_t vga_latch;
int vga_write_mode = 0;
int vga_logic_op = 0;
unsigned int fill_color = 0;
unsigned int fill_mask = 0;
int vga_rotate = 0;

int vga_planar = 0;

int ac_index_state = 1;
int vga_read_mode = 0;
unsigned char vga_color_compare = 0;
unsigned char vga_color_dontcare = 0;

int svga_page = 0;

extern unsigned char *scr;

const unsigned int bit_fill[16] = 
{
	0x00000000u, 0x000000FFu, 0x0000FF00u, 0x0000FFFFu, 0x00FF0000u, 0x00FF00FFu, 0x00FFFF00u, 0x00FFFFFFu,
	0xFF000000u, 0xFF0000FFu, 0xFF00FF00u, 0xFF00FFFFu, 0xFFFF0000u, 0xFFFF00FFu, 0xFFFFFF00u, 0xFFFFFFFFu
};

const unsigned int byte_fill[256] = {
	0x00000000, 0x01010101, 0x02020202, 0x03030303, 0x04040404, 0x05050505, 0x06060606, 0x07070707, 
	0x08080808, 0x09090909, 0x0A0A0A0A, 0x0B0B0B0B, 0x0C0C0C0C, 0x0D0D0D0D, 0x0E0E0E0E, 0x0F0F0F0F, 
	0x10101010, 0x11111111, 0x12121212, 0x13131313, 0x14141414, 0x15151515, 0x16161616, 0x17171717, 
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	0xF8F8F8F8, 0xF9F9F9F9, 0xFAFAFAFA, 0xFBFBFBFB, 0xFCFCFCFC, 0xFDFDFDFD, 0xFEFEFEFE, 0xFFFFFFFF, 
};

const unsigned char asciivga[] = {
	0x00, 0x00, 0x00, 0x00, 0x00, 0x00, 0x00, 0x00, 0x00, 0x00, 0x00, 0x00, 0x00, 0x00, 0x00, 0x00, 
	0x00, 0x00, 0x7E, 0x81, 0xA5, 0x81, 0x81, 0xBD, 0x99, 0x81, 0x81, 0x7E, 0x00, 0x00, 0x00, 0x00, 
	0x00, 0x00, 0x7E, 0xFF, 0xDB, 0xFF, 0xFF, 0xC3, 0xE7, 0xFF, 0xFF, 0x7E, 0x00, 0x00, 0x00, 0x00, 
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	0x00, 0x00, 0x00, 0x00, 0x00, 0x00, 0x00, 0x00, 0x00, 0x00, 0x42, 0x7E, 0x00, 0x00, 0x00, 0x00
};

#define BGR(b,g,r)          ((COLORREF)(((BYTE)(r)|((WORD)((BYTE)(g))<<8))|(((DWORD)(BYTE)(b))<<16)))

const unsigned long pal16[16] = {
	BGR(0, 0, 0), BGR(0, 0, 96), BGR(0, 96, 0), BGR(0, 96, 96),
	BGR(96, 0, 0), BGR(96, 0, 96), BGR(96, 96, 0), BGR(192, 192, 192),
	BGR(96, 96, 96), BGR(0, 0, 255), BGR(0, 255, 0), BGR(0, 255, 255),
	BGR(255, 0, 0), BGR(255, 0, 255), BGR(255, 255, 0), BGR(255, 255, 255),
};

const unsigned long pal16_vga[16] = {
	BGR(0, 0, 0), BGR(0, 0, 128), BGR(0, 128, 0), BGR(0, 128, 128),
	BGR(128, 0, 0), BGR(128, 0, 128), BGR(128, 128, 0), BGR(128, 128, 128),
	BGR(192, 192, 192), BGR(0, 0, 255), BGR(0, 255, 0), BGR(0, 255, 255),
	BGR(255, 0, 0), BGR(255, 0, 255), BGR(255, 255, 0), BGR(255, 255, 255),
};

const unsigned long pal16_ega[16] = {
	RGB(0, 0, 0), RGB(0, 0, 128), RGB(0, 128, 0), RGB(0, 128, 128),
	RGB(128, 0, 0), RGB(128, 0, 128), RGB(128, 128, 0), RGB(128, 128, 128),
	RGB(192, 192, 192), RGB(0, 0, 255), RGB(0, 255, 0), RGB(0, 255, 255),
	RGB(255, 0, 0), RGB(255, 0, 255), RGB(255, 255, 0), RGB(255, 255, 255),
};

const unsigned long pal16_pcjr[16] = {
	BGR(0, 0, 0), BGR(0, 0, 128), BGR(0, 128, 0), BGR(0, 128, 128),
	BGR(128, 0, 0), BGR(128, 0, 128), BGR(128, 128, 0), BGR(192, 192, 192),
	BGR(128, 128, 128), BGR(0, 0, 255), BGR(0, 255, 0), BGR(0, 255, 255),
	BGR(255, 0, 0), BGR(255, 0, 255), BGR(255, 255, 0), BGR(255, 255, 255),
};

const unsigned long palcga[5][4] = {
	{0, 10, 12, 14},
	{0, 11, 13, 15},
	{0, 10, 12, 14},
	{0, 11, 13, 15},
	{0, 10, 12, 14}
/*
	{BGR(0, 0, 0), BGR(0, 255, 0), BGR(255, 0, 0), BGR(255, 255, 0)},
	{BGR(0, 0, 0), BGR(0, 255, 255), BGR(255, 0, 255), BGR(255, 255, 255)},
	{BGR(0, 0, 0), BGR(0, 255, 0), BGR(255, 0, 0), BGR(255, 255, 96)},
	{BGR(0, 0, 0), BGR(64, 255, 255), BGR(255, 64, 255), BGR(255, 255, 255)},
	{BGR(0, 0, 0), BGR(0, 0, 255), BGR(64, 192, 192), BGR(255, 255, 255)}
*/
};

void CGADrawChar8x8(int x, int y, int ch, int attr)
{
	int i, j;
	const unsigned char *f = &ram[0xFFA6E + ch * 8];
	unsigned char b, m;
	unsigned long fg, bg;

	fg = attr & 0x0F; //pal16[attr & 0x0F];
	bg = (attr >> 4) & 0x0F; //pal16[(attr >> 4) & 0x0F];
	for (i = 0; i < 8; i++)
	{
		for (j = 0, m = 0x80; j < 8; j++)
		{
			b = *f;
			set_pixel_2x2(x + j, y + i, b & m ? fg : bg);
			m >>= 1;
		}
		f++;
	}
}

void CGADrawChar8x16r(int x, int y, int ch, int attr)
{
	int i, j;
	const unsigned char *f = &asciivga[ch * 16];
	unsigned char b, m;
	unsigned long fg, bg;

	fg = attr & 0x0F; //pal16[attr & 0x0F];
	bg = (attr >> 4) & 0x0F; //pal16[(attr >> 4) & 0x0F];
	for (i = 0; i < 16; i++)
	{
		for (j = 0, m = 0x01; j < 8; j++)
		{
			b = *f;
			set_pixel(x + j, y + i, b & m ? fg : bg);
			m <<= 1;
		}
		f++;
	}
}

void CGADrawChar8x16(int x, int y, int ch, int attr)
{
	int i, j;
	const unsigned char *f = &asciivga[ch * 16];
	unsigned char b, m;
	unsigned long fg, bg;

	fg = attr & 0x0F; //pal16[attr & 0x0F];
	bg = (attr >> 4) & 0x0F; //pal16[(attr >> 4) & 0x0F];
	for (i = 0; i < 16; i++)
	{
		for (j = 0, m = 0x80; j < 8; j++)
		{
			b = *f;
			set_pixel(x + j, y + i, b & m ? fg : bg);
			m >>= 1;
		}
		f++;
	}
}

void update_screen_text40_color()
{
	int i, j, k;
	const unsigned char *p = &ram[0xb8000];
	int cx = ram[0x450];
	int cy = ram[0x451];
	int blink = GetTickCount() % 1000 < 500;
	for (i = 0; i < 25; i++)
	{
		for (j = 0; j < 40; j++)
		{
			CGADrawChar8x8(j * 8, i * 8, p[0], p[1]);
			if ((i == cy) && (j == cx))
				if (blink)
					for (k = 0; k < 8; k++)
						set_pixel(k + j * 8, i * 8 + 7, pal16[p[1] & 0x0F]);
			p += 2;
		}
	}
}

void update_screen_text80_color()
{
	int i, j, k;
	const unsigned char *p = &ram[0xb8000];
	int cur = crt_regs[0x0E] * 256 + crt_regs[0x0F];
	static int blink = 0;
	p += (crt_regs[12] * 256 + crt_regs[13]) * 2;
	cur -= crt_regs[12] * 256 + crt_regs[13];

	blink++;

	int cx = cur % 80;
	int cy = cur / 80;
	for (i = 0; i < 25; i++)
	{
		for (j = 0; j < 80; j++)
		{
			CGADrawChar8x16(j * 8, i * 16, p[0], p[1]);
			if ((i == cy) && (j == cx))
				if (blink & 4)
					for (k = 0; k < 8; k++)
						set_pixel(k + j * 8, i * 16 + 15, p[1] & 0x0F);//pal16[p[1] & 0x0F]);
			p += 2;
		}
	}
}

void update_screen_col320x200()
{
	int i, j, k;
	const unsigned char *p;
	unsigned char b;
	unsigned long c;
	int cgapalindex;

	cgapalindex = 2;
	if (cga_color_cr & 4)
	{
		cgapalindex = 4;
	} else
	{
		if (cga_color_cr & 0x20)
		{
			if (cga_color_cr & 0x10)
				cgapalindex = 3;
			else
				cgapalindex = 1;
		} else
		{
			if (cga_color_cr & 0x10)
				cgapalindex = 2;
			else
				cgapalindex = 0;
		}
	}

	p = &ram[0xb8000];
	for (i = 0; i < 200; i += 2)
	{
		for (j = 0; j < 320; j += 4)
		{
			b = *p++;
			for (k = 0; k < 4; k++)
			{
				c = palcga[cgapalindex][(b >> 6) & 3];
				b <<= 2;
				set_pixel_2x2(k + j, i, c);
			}
		}
	}
	p = &ram[0xbA000];
	for (i = 1; i < 200; i += 2)
	{
		for (j = 0; j < 320; j += 4)
		{
			b = *p++;
			for (k = 0; k < 4; k++)
			{
				c = palcga[cgapalindex][(b >> 6) & 3];
				b <<= 2;
				set_pixel_2x2(k + j, i, c);
			}
		}
	}
}

void update_screen_ega320x200()
{
	int i, j, k, l;
	const unsigned char *p;
	unsigned char b;
	unsigned long c;

	for (l = 0; l < 4; l++)
	{
		p = &ram[0xB8000 + l * 8192];
		for (i = l; i < 200; i += 4)
		{
			for (j = 0; j < 320; j += 2)
			{
				b = *p++;
				for (k = 0; k < 2; k++)
				{
					c = pal16_pcjr[(b >> 4) & 15];
					b <<= 4;
					set_pixel_2x2(k + j, i, c);
				}
			}
		}
	}
}

void update_screen_vga320x200()
{
	int i, j;
	const unsigned char *p;
	const unsigned long *pal = (const unsigned long *)vga_palette;

	p = &ram[0xA0000];
	for (i = 0; i < 200; i++)
	{
		for (j = 0; j < 320; j++)
		{
			set_pixel_2x2(j, i, *p++);//pal[*p++]);
		}
	}
}

void update_screen_vga640x480x8()
{
	int i, j;
	const unsigned char *p;
	const unsigned long *pal = (const unsigned long *)vga_palette;

	vga_pan = 0;
	p = (unsigned char *)vram;
	for (i = 0; i < 480; i++)
	{
		for (j = 0; j < 640; j++)
		{
			set_pixel(j, i, *p++);//pal[*p++]);
		}
		p += vga_pan;
	}
}

void update_screen_vga320x200x()
{
	int i, j;
	const unsigned int *p;
	const unsigned long *pal = (const unsigned long *)vga_palette;
	unsigned char b;
	unsigned long c;
	unsigned int d;
	int lines = 200;
	int pixel_shift;
	p = &vram[(crt_regs[12] * 256 + crt_regs[13]) / 1];
	pixel_shift = 0;

	// TODO: find out how to do it right
	if (crt_regs[0x13] > 40)
		vga_pan = (crt_regs[0x13] - (crt_regs[1] + 1) / 2) * 2;
	else
		vga_pan = 0;

	// HPAN
	p += ac_regs[0x13] & 0x0F;

	lines = crt_regs[0x12] + ((crt_regs[7] >> 1) & 0x01) * 256 + ((crt_regs[7] >> 6) & 0x01) * 512;

	if (crt_regs[0x10] & 4)
		lines /= 2;

	if (lines > 240)
	{
		for (i = 0; i < lines; i++)
		{
			for (j = 0; j < 320; j++)
			{
				if ((j & 3) == 0)
					d = *p++;
				else
					d >>= 8;
				b = d;
				c = pal[b];
				if (j - pixel_shift >= 0)
					set_pixel_2x1(j - pixel_shift, i, c);
			}
			p += vga_pan;
		}
		return;
	}

#if (STM32)
	unsigned short *fb = (unsigned short *)scr;
	unsigned short cp;
#endif
	
	for (i = 0; i < lines; i++)
	{
		for (j = 0; j < 320; j++)
		{
			if ((j & 3) == 0)
				d = *p++;
			else
				d >>= 8;
			b = d;
			c = b;//pal[b];
#if (STM32)
			cp = b + (b << 8);
			*fb = cp;
			fb[320] = cp;
			fb++;
#else
			set_pixel_2x2(j, i, c);
#endif
		}
		p += vga_pan;
#if (STM32)
		fb += 320;
#endif
	}
}

void update_screen_bw640x200()
{
	int i, j, k;
	const unsigned char *p;
	unsigned char b;
	unsigned long c;
	p = &ram[0xb8000];
	for (i = 0; i < 200; i += 2)
	{
		for (j = 0; j < 640; j += 8)
		{
			b = *p++;
			for (k = 0; k < 8; k++)
			{
				c = b & 0x80 ? 15 : 0;
				b <<= 1;
				set_pixel_1x2(k + j, i, c);
			}
		}
		if (p >= &ram[0xba000])
			p -= 8192;
	}
	p = &ram[0xbA000];
	for (i = 1; i < 200; i += 2)
	{
		for (j = 0; j < 640; j += 8)
		{
			b = *p++;
			for (k = 0; k < 8; k++)
			{
				c = b & 0x80 ? 15 : 0;
				b <<= 1;
				set_pixel_1x2(k + j, i, c);
			}
		}
		if (p >= &ram[0xbc000])
			p -= 8192;
	}
}

void update_screen_bw640x480()
{
	int i, j, k;
	const unsigned char *p;
	unsigned char b;
	unsigned long c;
	p = &ram[0xA0000];
	for (i = 0; i < 480; i++)
	{
		for (j = 0; j < 640; j += 8)
		{
			b = *p++;
			for (k = 0; k < 8; k++)
			{
				c = b & 0x80 ? 15 : 0;
				b <<= 1;
				set_pixel(k + j, i, c);
			}
		}
	}
}

void update_screen_ega320x200d()
{
	int i, j, k;
	const unsigned int *p;
	unsigned char c;
	unsigned int b;

	p = &vram[(crt_regs[12] * 256 + crt_regs[13]) / 1];
	if (crt_regs[0x13] > 40)
		vga_pan = (crt_regs[0x13] - 40) * 4 - 2;
	else
		vga_pan = 0;
	for (i = 0; i < 200; i++)
	{
		for (j = 0; j < 320; j += 8)
		{
			b = *p++;
			for (k = 0; k < 8; k++)
			{
				c = 0;
				c = (b & 0x80) ? 4 : 0;
				c |= (b & 0x8000) ? 2 : 0;
				c |= (b & 0x800000) ? 1 : 0;
				c |= (b & 0x80000000ul) ? 8 : 0;
				b <<= 1;

				set_pixel_2x2(j + k, i, c);
			}
		}
		p += vga_pan;
	}
}

void update_screen_ega640x350()
{
	int i, j, k;
	const unsigned int *p;
	unsigned char c;
	unsigned long b;
	p = vram;
	if (crt_regs[0x13] > 40)
		vga_pan = (crt_regs[0x13] - 40) * 2;
	else
		vga_pan = 0;
	for (i = 0; i < 350; i++)
	{
		for (j = 0; j < 640; j += 8)
		{
			b = *p++;
			for (k = 0; k < 8; k++)
			{
				c = 0;
				c = (b & 0x80) ? 1 : 0;
				c |= (b & 0x8000) ? 2 : 0;
				c |= (b & 0x800000) ? 4 : 0;
				c |= (b & 0x80000000ul) ? 8 : 0;
				b <<= 1;
				set_pixel(k + j, i, c);
			}
		}
		p += vga_pan;
	}
}

void update_screen_vga640x480()
{
	int i, j, k;
	const unsigned int *p;
#if (STM32)
	unsigned char *s = scr;
#endif
	unsigned char c;
	unsigned long b;
	p = vram;
	for (i = 0; i < 480; i++)
	{
		for (j = 0; j < 640; j += 8)
		{
			b = *p++;
			for (k = 0; k < 8; k++)
			{
				c = (b & 0x80) ? 4 : 0;
				c |= (b & 0x8000) ? 2 : 0;
				c |= (b & 0x800000) ? 1 : 0;
				c |= (b & 0x80000000ul) ? 8 : 0;
				b <<= 1;
#if (STM32)
				*s++ = c;
#else
				set_pixel(k + j, i, c);
#endif
			}
		}
	}
}

void update_screen()
{
	vga_lines = 400;
	switch (vmode)
	{
		case VMODE_BW40x25:
		case VMODE_COL40x25:
			update_screen_text40_color();
			break;
		case VMODE_BW80x25:
		case VMODE_COL80x25:
			update_screen_text80_color();
			break;
		case VMODE_COL320x200:
		case 5:
			update_screen_col320x200();
			break;
		case VMODE_BW640x200:
			update_screen_bw640x200();
			break;
		case VMODE_BW640x480:
			update_screen_bw640x480();
			vga_lines = 480;
			break;
		case VMODE_EGA320x200:
			update_screen_ega320x200();
			break;
		case VMODE_EGA320x200D:
			update_screen_ega320x200d();
			break;
		case VMODE_EGA640x350:
			update_screen_ega640x350();
			vga_lines = 350;
			break;
		case VMODE_VGA320x200:
			if (sq_regs[4] & 0x08)
				update_screen_vga320x200();
			else
				update_screen_vga320x200x();
			break;
		case VMODE_VGA640x480:
			update_screen_vga640x480();
			vga_lines = 480;
			break;
		case VMODE_VGA640x480x8:
			update_screen_vga640x480x8();
			break;
	}
}

// Windows working good
unsigned int vga_logic(unsigned int v, unsigned int mask)
{
	switch (vga_logic_op)
	{
		case 0: return (v & mask) | (vga_latch.d & (~mask));
		case 1: return (v | (~mask)) & vga_latch.d;
		case 2: return (v & mask) | vga_latch.d;
		case 3: return (v & mask) ^ vga_latch.d;
	}
	return v;
}

void vga_portwrite(unsigned short port, unsigned char value)
{
	/*
	switch (port)
	{
		case 0x3c01:
			if (!ac_index_state)
				fprintf(c0, "ac[%x]: %x\n", ac_index, value);
			break;
		case 0x3c4:
		case 0x3ce:
		case 0x3b4:
		case 0x3d4:
		case 0x3c6:
		case 0x3c7:
		case 0x3c8:
		case 0x3c9:
			break;
		case 0x3c5:
			fprintf(c0, "sq[%x]: %x\n", sq_index, value);
			break;
		case 0x3cf:
			fprintf(c0, "gc[%x]: %x\n", gc_index, value);
			break;
		case 0x3b5:
		case 0x3d5:
			fprintf(c0, "crt[%x]: %x\n", crt_index, value);
			break;
		default:
			fprintf(c0, "[%x]: %x\n", port, value);
			break;
	}
	*/

	switch (port)
	{
		case 0x3C0:
			if (ac_index_state)
			{
				ac_index = value;
			} else
			{
				if (ac_index < sizeof(ac_regs))
					ac_regs[ac_index] = value;
				if (ac_index < 16)
				{
					ega_palette[ac_index] = RGB(
						(value & 0x01 ? 0xAA : 0) | (value & 0x08 ? 0x55 : 0),
						(value & 0x02 ? 0xAA : 0) | (value & 0x10 ? 0x55 : 0),
						(value & 0x04 ? 0xAA : 0) | (value & 0x20 ? 0x55 : 0));
					if (vmode < 0x13)
					{
						vga_palette[ac_index * 3 + 2] = (value & 0x01 ? 0x2A : 0) | (value & 0x08 ? 0x15 : 0);
						vga_palette[ac_index * 3 + 1] = (value & 0x02 ? 0x2A : 0) | (value & 0x10 ? 0x15 : 0);
						vga_palette[ac_index * 3 + 0] = (value & 0x04 ? 0x2A : 0) | (value & 0x20 ? 0x15 : 0);
						
						hw_set_palette(ac_index,
							(value & 0x01 ? 0x80 : 0) | (value & 0x08 ? 0x40 : 0),
							(value & 0x02 ? 0x80 : 0) | (value & 0x10 ? 0x40 : 0),
							(value & 0x04 ? 0x80 : 0) | (value & 0x20 ? 0x40 : 0));
					}
				}
			}
			ac_index_state = !ac_index_state;
			break;
		case 0x3C4:
			sq_index = value;
			break;
		case 0x3C5:
			if (sq_index < 16)
				sq_regs[sq_index] = value;
			if (sq_index == 2)
				vga_plane_mask = bit_fill[value & 0x0F];
			break;
		case 0x3CE:
			gc_index = value;
			break;
		case 0x3CF:
			if (gc_index < sizeof(gc_regs))
				gc_regs[gc_index] = value;
			switch (gc_index)
			{
				case 0:
					fill_color = bit_fill[value & 0x0F];
					break;
				case 1:
					fill_mask = bit_fill[value & 0x0F];
					break;
				case 2:
					vga_color_compare = value & 0x0F;
					break;
				case 3:
					vga_rotate = value & 0x07;
					vga_logic_op = (value >> 3) & 3;
					break;
				case 4:
					vga_read_map = value & 3;
					break;
				case 5:
					vga_write_mode = value & 3;
					vga_read_mode = (value >> 3) & 1;
					break;
				case 7:
					vga_color_dontcare = value & 0x0F;
					break;
				case 8:
					write_mask = byte_fill[value];
					break;
			}
			break;
		case 0x3C6:
			vga_pal_mask = value;
			break;
		case 0x3C7:
			vga_pal_read_index = value * 4;
			break;
		case 0x3C8:
			vga_pal_index = value * 4;
			break;
		case 0x3C9:
			switch (vga_pal_index & 3)
			{
				case 0:
					vga_palette[(vga_pal_index & (vga_pal_mask << 2)) | 2] = value << 2;
					break;
				case 1:
					vga_palette[(vga_pal_index & (vga_pal_mask << 2)) | 1] = value << 2;
					break;
				case 2:
					vga_palette[(vga_pal_index & (vga_pal_mask << 2)) | 0] = value << 2;
					vga_pal_index++;
					
					hw_set_palette(
						(vga_pal_index & (vga_pal_mask << 2)) >> 2,
						vga_palette[(vga_pal_index & (vga_pal_mask << 2)) | 2],
						vga_palette[(vga_pal_index & (vga_pal_mask << 2)) | 1],
						vga_palette[(vga_pal_index & (vga_pal_mask << 2)) | 0]);
					
					break;
			}
			vga_pal_index++;
			vga_pal_index &= (vga_pal_mask << 2) | 3;
			break;
		case 0x3B4:
		case 0x3D4:
			crt_index = value;
			break;
		case 0x3B5:
		case 0x3D5:
			if (crt_index < 32)
				crt_regs[crt_index] = value;
			break;
		case 0x3D9:
			cga_color_cr = value;
			break;
		case 0x3DC:
			svga_page = value & 7;
			break;
	}
}

unsigned char vga_portread(unsigned short port)
{
	static int p3da = 0;
	switch (port)
	{
		case 0x3ba:
		case 0x3da:
			ac_index_state = 1;
			p3da++;
			return ports[port];
			return /*ports[port];*/(p3da & 0x04 ? 1 : 0) + (p3da & 0x100 ? 8 : 0);
		case 0x3C1:
			if (ac_index < sizeof(ac_regs))
				return ac_regs[ac_index];
			return 0;
		case 0x3C7:
			return vga_pal_read_index / 4;
		case 0x3C8:
			return vga_pal_index / 4;
		case 0x3C9:
			vga_pal_read_index++;
			vga_pal_read_index &= (vga_pal_mask << 2) | 3;
			switch (vga_pal_read_index & 3)
			{
				case 0:
				case 1:
					return vga_palette[(vga_pal_read_index & (vga_pal_mask << 2)) | 2] >> 2;
				case 2:
					return vga_palette[(vga_pal_read_index & (vga_pal_mask << 2)) | 1] >> 2;
				case 3:
					return vga_palette[(vga_pal_read_index++ & (vga_pal_mask << 2)) | 0] >> 2;
			}
			break;
		case 0x3C4:
			return sq_index;
		case 0x3C5:
			return sq_index < sizeof(sq_regs) ? sq_regs[sq_index] : 0;
		case 0x3CE:
			return gc_index;
		case 0x3CF:
			return gc_index < sizeof(gc_regs) ? gc_regs[gc_index] : 0;
	}
	return 0;
}

unsigned char vga_memread(unsigned int addr)
{
	reg_t r;
	unsigned char *c;

	if (vmode == 0x14)
	{
		c = (unsigned char *)vram;
		return c[addr - 0xA0000 + svga_page * 65536u];
	}

	if ((sq_regs[4] & 0x08) != 0)
		return ram[addr];

	vga_latch.d = vram[addr - 0xA0000];
	if (vga_read_mode == 1)
	{
		r.d = (vga_latch.d & bit_fill[vga_color_dontcare]) ^ bit_fill[vga_color_compare & vga_color_dontcare];

		return ~(r.b[0] | r.b[1] | r.b[2] | r.b[3]);
	}
	return vga_latch.b[vga_read_map];
}

void vga_memwrite(unsigned int addr, unsigned char value)
{
	unsigned int v, r, m;
	unsigned int *p;
	unsigned char *c;
	
	if (vmode == 0x14)
	{
		c = (unsigned char *)vram;
		c[addr - 0xA0000 + svga_page * 65536u] = value;
		return;
	}

	if ((sq_regs[4] & 0x08) != 0)
	{
		ram[addr] = value;
		return;
	}

	p = &vram[addr - 0xA0000];
	switch (vga_write_mode)
	{
		case 0:
			if (vga_rotate)
				value = (value >> vga_rotate) | (value << (8 - vga_rotate));
			v = byte_fill[value];
			v = (fill_color & fill_mask) | (v & (~fill_mask));
			r = vga_logic(v, write_mask);
			break;
		case 1:
			r = vga_latch.d;
			break;
		case 2:
			v = bit_fill[value & 0x0F];
			r = vga_logic(v, write_mask);
			break;
		case 3:
			if (vga_rotate)
				value = (value >> vga_rotate) | (value << (8 - vga_rotate));
			v = byte_fill[value];
			r = vga_logic(fill_color, v & write_mask);
			break;
	}
	m = vga_plane_mask;
	*p = (r & m) | (*p & (~m));
}
